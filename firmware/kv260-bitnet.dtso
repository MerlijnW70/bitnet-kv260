/dts-v1/;
/plugin/;
/ {
	fragment@0 {
		target = <&fpga_full>;
		__overlay__ {
			#address-cells = <2>;
			#size-cells = <2>;
			firmware-name = "kv260-bitnet.bit.bin";
			resets = <&zynqmp_reset 116>, <&zynqmp_reset 117>, <&zynqmp_reset 118>, <&zynqmp_reset 119>;
		};
	};
	fragment@1 {
		target = <&amba>;
		__overlay__ {
			clocking0: clocking0 {
				#clock-cells = <0>;
				compatible = "xlnx,fclk";
				clocks = <&zynqmp_clk 71>;
				assigned-clocks = <&zynqmp_clk 71>;
				assigned-clock-rates = <200000000>;
				clock-output-names = "fabric_clk";
			};
		};
	};
};
